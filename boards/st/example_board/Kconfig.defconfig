## boards/st/example_board/Kconfig.defconfig
```kconfig
# Example board (STM32H753ZI) configuration

# Copyright (c) 2021 Blue Clover Devices
# SPDX-License-Identifier: Apache-2.0

if BOARD_EXAMPLE_BOARD

configdefault ETH_DRIVER
	default y

endif # BOARD_EXAMPLE_BOARD
```

## boards/st/example_board/Kconfig.example_board
```kconfig
# Copyright (c) 2021 Blue Clover Devices
# SPDX-License-Identifier: Apache-2.0

config BOARD_EXAMPLE_BOARD
	select SOC_STM32H753XX
```

## boards/st/example_board/board.yml
```yaml
board:
  name: example_board
  full_name: Example Board
  vendor: st
  socs:
    - name: stm32h753xx
```
